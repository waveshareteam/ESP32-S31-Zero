## examples/esp-idf/08_wifi_sta/main/Kconfig.projbuild
```kconfig
menu "Example Configuration"

    config EXAMPLE_WIFI_SSID
        string "Wi-Fi SSID"
        default "myssid"

    config EXAMPLE_WIFI_PASSWORD
        string "Wi-Fi password"
        default "mypassword"

    config EXAMPLE_MAXIMUM_RETRY
        int "Maximum connection retries"
        range 1 100
        default 10

endmenu
```

## examples/esp-idf/09_wifi_ap/main/Kconfig.projbuild
```kconfig
menu "Example Configuration"

    config EXAMPLE_WIFI_AP_SSID
        string "SoftAP SSID"
        default "ESP32-S31-Zero"

    config EXAMPLE_WIFI_AP_PASSWORD
        string "SoftAP password (empty for open network)"
        default "12345678"

    config EXAMPLE_WIFI_AP_CHANNEL
        int "SoftAP channel"
        range 1 13
        default 1

    config EXAMPLE_WIFI_AP_MAX_CONNECTIONS
        int "Maximum client connections"
        range 1 10
        default 4

endmenu
```

## examples/esp-idf/09_wifi_ap/sdkconfig.defaults
```kconfig
CONFIG_ESPTOOLPY_FLASHSIZE_16MB=y
CONFIG_ESPTOOLPY_FLASHMODE_DIO=y
CONFIG_ESPTOOLPY_FLASHFREQ_80M=y
CONFIG_PARTITION_TABLE_CUSTOM=y
CONFIG_PARTITION_TABLE_CUSTOM_FILENAME="partitions.csv"
CONFIG_ESP_CONSOLE_USB_SERIAL_JTAG=y
CONFIG_ESP_CONSOLE_SECONDARY_NONE=y
CONFIG_EXAMPLE_WIFI_AP_SSID="ESP32-S31-Zero"
CONFIG_EXAMPLE_WIFI_AP_PASSWORD="12345678"
CONFIG_EXAMPLE_WIFI_AP_CHANNEL=1
CONFIG_EXAMPLE_WIFI_AP_MAX_CONNECTIONS=4
```

## examples/esp-idf/10_ble_advertiser/sdkconfig.defaults
```kconfig
CONFIG_ESPTOOLPY_FLASHSIZE_16MB=y
CONFIG_ESPTOOLPY_FLASHMODE_DIO=y
CONFIG_ESPTOOLPY_FLASHFREQ_80M=y
CONFIG_PARTITION_TABLE_CUSTOM=y
CONFIG_PARTITION_TABLE_CUSTOM_FILENAME="partitions.csv"
CONFIG_ESP_CONSOLE_USB_SERIAL_JTAG=y
CONFIG_ESP_CONSOLE_SECONDARY_NONE=y
CONFIG_BT_ENABLED=y
CONFIG_BTDM_CTRL_MODE_BLE_ONLY=y
# CONFIG_BT_BLUEDROID_ENABLED is not set
CONFIG_BT_NIMBLE_ENABLED=y
CONFIG_BT_NIMBLE_ROLE_BROADCASTER=y
CONFIG_BT_NIMBLE_ROLE_PERIPHERAL=y
```

## examples/esp-idf/11_board_test/main/Kconfig.projbuild
```kconfig
menu "Board test"
    config BOARD_TOUCH_TRACKING
        bool "Enable continuous touch sampling and touch marker"
        default n
        help
            Enable runtime GT911 sampling, the finger-following marker and
            touch diagnostics. Disabled by default because touch communication
            is not yet reliable on the tested hardware. The startup GT911
            detection test runs regardless of this option.
endmenu
```

## examples/esp-idf/12_wifi_performance/sdkconfig.defaults
```kconfig
# ESP32-S31-Zero board settings
CONFIG_ESPTOOLPY_FLASHSIZE_16MB=y
CONFIG_ESPTOOLPY_FLASHMODE_DIO=y
CONFIG_ESPTOOLPY_FLASHFREQ_80M=y
CONFIG_PARTITION_TABLE_CUSTOM=y
CONFIG_PARTITION_TABLE_CUSTOM_FILENAME="partitions.csv"
CONFIG_ESP_CONSOLE_USB_SERIAL_JTAG=y
CONFIG_ESP_CONSOLE_SECONDARY_NONE=y

# Espressif iperf performance settings
CONFIG_COMPILER_OPTIMIZATION_PERF=y
CONFIG_ESP_SYSTEM_EVENT_TASK_STACK_SIZE=4096
CONFIG_ESP_MAIN_TASK_STACK_SIZE=6144
CONFIG_FREERTOS_UNICORE=n
CONFIG_FREERTOS_HZ=1000
CONFIG_FREERTOS_IN_IRAM=y
CONFIG_ESP_INT_WDT=n
CONFIG_ESP_TASK_WDT_EN=n

CONFIG_ESP_WIFI_STATIC_RX_BUFFER_NUM=48
CONFIG_ESP_WIFI_DYNAMIC_RX_BUFFER_NUM=72
CONFIG_ESP_WIFI_DYNAMIC_TX_BUFFER_NUM=64
CONFIG_ESP_WIFI_AMPDU_TX_ENABLED=y
CONFIG_ESP_WIFI_TX_BA_WIN=64
CONFIG_ESP_WIFI_AMPDU_RX_ENABLED=y
CONFIG_ESP_WIFI_RX_BA_WIN=64
CONFIG_ESP_WIFI_NVS_ENABLED=n
CONFIG_ESP_WIFI_SLP_IRAM_OPT=y
CONFIG_ESP_WIFI_ENABLE_WIFI_TX_STATS=y
CONFIG_ESP_WIFI_ENABLE_WIFI_RX_STATS=y
CONFIG_ESP_WIFI_ENABLE_WIFI_RX_MU_STATS=n

CONFIG_LWIP_IRAM_OPTIMIZATION=y
CONFIG_LWIP_EXTRA_IRAM_OPTIMIZATION=y
CONFIG_LWIP_TCPIP_TASK_PRIO=23
CONFIG_LWIP_TCP_SND_BUF_DEFAULT=65535
CONFIG_LWIP_TCP_WND_DEFAULT=65535
CONFIG_LWIP_TCP_RECVMBOX_SIZE=64
CONFIG_LWIP_UDP_RECVMBOX_SIZE=64
CONFIG_LWIP_TCPIP_RECVMBOX_SIZE=64
CONFIG_LWIP_IP_REASS_MAX_PBUFS=15
CONFIG_LWIP_TCPIP_TASK_AFFINITY_CPU1=y
CONFIG_LWIP_TCPIP_TASK_AFFINITY=0x1
CONFIG_LWIP_TCP_OOSEQ_MAX_PBUFS=12

CONFIG_IPERF_DEF_TCP_TX_BUFFER_LEN=2880

# ESP32-S31 iperf target defaults
CONFIG_MBEDTLS_HARDWARE_AES=n
CONFIG_MBEDTLS_HARDWARE_MPI=n
CONFIG_MBEDTLS_HARDWARE_SHA=n
CONFIG_MBEDTLS_HARDWARE_ECC=n
```
